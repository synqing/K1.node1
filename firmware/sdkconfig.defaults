## firmware/sdkconfig.defaults
```kconfig
# ESP32-S3 SDK Configuration Defaults
# Core dump and debugging configuration

# Core dump to flash
CONFIG_ESP_COREDUMP_ENABLE_TO_FLASH=y
CONFIG_ESP_COREDUMP_MAX_TASKS=64
CONFIG_ESP_COREDUMP_STACK_SIZE=1024
CONFIG_ESP_COREDUMP_CORES=1
CONFIG_ESP_COREDUMP_CAPTURE_DRAM=y
CONFIG_ESP_COREDUMP_CAPTURE_DRAM_SIZE=0x1000

# Exception and panic handling
CONFIG_ESP_SYSTEM_PANIC_PRINT_HALT=n
CONFIG_ESP_SYSTEM_PANIC_PRINT_REBOOT=y
CONFIG_ESP_SYSTEM_PANIC_SILENT_REBOOT=n
CONFIG_ESP_SYSTEM_PANIC_GDBSTUB=n

# Debug output
CONFIG_ESP_DEBUG_OCDAWARE=y
CONFIG_ESP_SYSTEM_CHECK_INT_LEVEL_5=n

# Memory debugging
CONFIG_ESP_DEBUG_STUBS_ENABLE=n
CONFIG_ESP_TRACEMEM_ENABLE=n

# Task debugging
CONFIG_ESP_TASK_WDT=y
CONFIG_ESP_TASK_WDT_TIMEOUT_S=10
CONFIG_ESP_TASK_WDT_CHECK_IDLE_TASK_CPU0=y
CONFIG_ESP_TASK_WDT_CHECK_IDLE_TASK_CPU1=y
```
